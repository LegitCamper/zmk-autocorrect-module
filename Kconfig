## boards/shields/autocorrect_adapter/Kconfig.shield
```kconfig
config SHIELD_AUTOCORRECT_ADAPTER
	def_bool $(shields_list_contains,autocorrect_adapter) 
```

## modules/auto_correct_adapter/Kconfig.shield
```kconfig
config SHIELD_AUTO_CORRECT_ADAPTER
    def_bool $(shields_list_contains,auto_correct_adapter)
```
